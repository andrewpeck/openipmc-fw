# file: openipmc-fw.ioc
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CORTEX_M7.AccessPermission-Cortex_Memory_Protection_Unit_Region0_Settings=MPU_REGION_FULL_ACCESS
CORTEX_M7.AccessPermission-Cortex_Memory_Protection_Unit_Region1_Settings=MPU_REGION_FULL_ACCESS
CORTEX_M7.BaseAddress-Cortex_Memory_Protection_Unit_Region0_Settings=0x30040000
CORTEX_M7.BaseAddress-Cortex_Memory_Protection_Unit_Region1_Settings=0x30040000
CORTEX_M7.CPU_DCache=Enabled
CORTEX_M7.CPU_ICache=Enabled
CORTEX_M7.DisableExec-Cortex_Memory_Protection_Unit_Region0_Settings=MPU_INSTRUCTION_ACCESS_DISABLE
CORTEX_M7.DisableExec-Cortex_Memory_Protection_Unit_Region1_Settings=MPU_INSTRUCTION_ACCESS_DISABLE
CORTEX_M7.Enable-Cortex_Memory_Protection_Unit_Region0_Settings=MPU_REGION_ENABLE
CORTEX_M7.Enable-Cortex_Memory_Protection_Unit_Region1_Settings=MPU_REGION_ENABLE
CORTEX_M7.IsBufferable-Cortex_Memory_Protection_Unit_Region1_Settings=MPU_ACCESS_BUFFERABLE
CORTEX_M7.IsCacheable-Cortex_Memory_Protection_Unit_Region1_Settings=MPU_ACCESS_NOT_CACHEABLE
CORTEX_M7.IsShareable-Cortex_Memory_Protection_Unit_Region1_Settings=MPU_ACCESS_SHAREABLE
CORTEX_M7.MPU_Control=MPU_PRIVILEGED_DEFAULT
CORTEX_M7.Size-Cortex_Memory_Protection_Unit_Region0_Settings=MPU_REGION_SIZE_32KB
CORTEX_M7.Size-Cortex_Memory_Protection_Unit_Region1_Settings=MPU_REGION_SIZE_256B
CORTEX_M7.TypeExtField-Cortex_Memory_Protection_Unit_Region0_Settings=MPU_TEX_LEVEL1
CRC.InputDataInversionMode=CRC_INPUTDATA_INVERSION_BYTE
CRC.OutputDataInversionMode=CRC_OUTPUTDATA_INVERSION_ENABLE
CortexM4.IPs=BDMA,CORTEX_M4\:I,DEBUG,DMA,FATFS_M4\:I,FREERTOS_M4\:I,IWDG2\:I,MDMA,NVIC2\:I,OPENAMP_M4\:I,PDM2PCM_M4\:I,PWR,RCC,RESMGR_UTILITY,SYS_M4\:I,USB_DEVICE_M4\:I,USB_HOST_M4\:I,VREFBUF,WWDG2\:I,TIM6\:I
CortexM7.IPs=BDMA\:I,CORTEX_M7\:I,DEBUG\:I,DMA\:I,FATFS_M7\:I,FREERTOS_M7\:I,IWDG1\:I,MDMA\:I,NVIC1\:I,OPENAMP_M7\:I,PDM2PCM_M7\:I,PWR\:I,RCC\:I,RESMGR_UTILITY\:I,SYS\:I,USB_DEVICE_M7\:I,USB_HOST_M7\:I,VREFBUF\:I,WWDG1\:I,TIM7\:I,UART4\:I,I2C1\:I,I2C2\:I,SPI4\:I,I2C4\:I,I2C3\:I,ETH\:I,LWIP\:I,USB_OTG_FS\:I,CRC\:I,QUADSPI\:I
CortexM7.Pins=PI6,PI5,PI4,PB5,PI7,PE1,PE0,PI3,PE3,PG14,PA10,PC13,PI8,PC7,PC6,PG8,PF2,PG5,PI12,PI13,PI14,PF3,PG4,PG3,PG2,PK2,PF5,PF4,PK0,PK1,PJ11,PC0,PJ10,PJ9,PA0,PJ0,PE10,PJ8,PJ7,PJ6,PH4,PH5,PI15,PJ1,PF13,PE9,PE11,PB10,PH10,PH11,PD15,PD14,PA6,PB2,PF12,PE12,PE15,PJ5,PH9,PH12,PD11,PD12,PD13,PA5,PJ2,PF11,PG0,PE8,PE13,PH8,PB12,PB15,PD10,PD9,PA3,PA4,PB0,PJ3,PJ4,PG1,PE7,PE14,PH7,PB13,PB14,PD8
Dma.Request0=SPI4_TX
Dma.Request1=SPI4_RX
Dma.SPI4_RX.1.Direction=DMA_PERIPH_TO_MEMORY
Dma.SPI4_RX.1.EventEnable=DISABLE
Dma.SPI4_RX.1.FIFOMode=DMA_FIFOMODE_DISABLE
Dma.SPI4_RX.1.Instance=DMA1_Stream1
Dma.SPI4_RX.1.MemDataAlignment=DMA_MDATAALIGN_BYTE
Dma.SPI4_RX.1.MemInc=DMA_MINC_ENABLE
Dma.SPI4_RX.1.Mode=DMA_NORMAL
Dma.SPI4_RX.1.PeriphDataAlignment=DMA_PDATAALIGN_BYTE
Dma.SPI4_RX.1.PeriphInc=DMA_PINC_DISABLE
Dma.SPI4_RX.1.Polarity=HAL_DMAMUX_REQ_GEN_RISING
Dma.SPI4_RX.1.Priority=DMA_PRIORITY_LOW
Dma.SPI4_RX.1.RequestNumber=1
Dma.SPI4_RX.1.SignalID=NONE
Dma.SPI4_RX.1.SyncEnable=DISABLE
Dma.SPI4_RX.1.SyncPolarity=HAL_DMAMUX_SYNC_NO_EVENT
Dma.SPI4_RX.1.SyncRequestNumber=1
Dma.SPI4_RX.1.SyncSignalID=NONE
Dma.SPI4_TX.0.Direction=DMA_MEMORY_TO_PERIPH
Dma.SPI4_TX.0.EventEnable=DISABLE
Dma.SPI4_TX.0.FIFOMode=DMA_FIFOMODE_DISABLE
Dma.SPI4_TX.0.Instance=DMA1_Stream0
Dma.SPI4_TX.0.MemDataAlignment=DMA_MDATAALIGN_BYTE
Dma.SPI4_TX.0.MemInc=DMA_MINC_ENABLE
Dma.SPI4_TX.0.Mode=DMA_NORMAL
Dma.SPI4_TX.0.PeriphDataAlignment=DMA_PDATAALIGN_BYTE
Dma.SPI4_TX.0.PeriphInc=DMA_PINC_DISABLE
Dma.SPI4_TX.0.Polarity=HAL_DMAMUX_REQ_GEN_RISING
Dma.SPI4_TX.0.Priority=DMA_PRIORITY_LOW
Dma.SPI4_TX.0.RequestNumber=1
Dma.SPI4_TX.0.SignalID=NONE
Dma.SPI4_TX.0.SyncEnable=DISABLE
Dma.SPI4_TX.0.SyncPolarity=HAL_DMAMUX_SYNC_NO_EVENT
Dma.SPI4_TX.0.SyncRequestNumber=1
Dma.SPI4_TX.0.SyncSignalID=NONE
ETH.MediaInterface=HAL_ETH_MII_MODE
FREERTOS_M7.Tasks01=defaultTask,24,256,StartDefaultTask,Default,NULL,Dynamic,NULL,NULL
FREERTOS_M7.configCHECK_FOR_STACK_OVERFLOW=2
FREERTOS_M7.configTOTAL_HEAP_SIZE=35480
FREERTOS_M7.configUSE_MALLOC_FAILED_HOOK=1
I2C1.NoStretchMode=I2C_NOSTRETCH_ENABLE
I2C1.Timing=0x10C0ECFF
I2C2.NoStretchMode=I2C_NOSTRETCH_ENABLE
I2C2.Timing=0x10C0ECFF
I2C3.NoStretchMode=I2C_NOSTRETCH_ENABLE
I2C3.Timing=0x10C0ECFF
I2C4.CustomTiming=Disabled
I2C4.NoStretchMode=I2C_NOSTRETCH_ENABLE
I2C4.Speed=30
I2C4.Timing=0x90204DFD
LWIP.CMSIS_VERSION-Enabled=1
LWIP.IP_ADDRESS=192.168.000.010
LWIP.LWIP_DHCP=0
LWIP.MEM_SIZE=16360
LWIP.NETMASK_ADDRESS=255.255.255.000
LWIP.Version=v2.1.2_Cube
Mcu.Family=STM32H7
Mcu.Name=STM32H745XIHx
Mcu.Package=TFBGA240
NVIC1.DMA1_Stream0_IRQn=true\:5\:0\:false\:false\:true\:true\:false\:true
NVIC1.DMA1_Stream1_IRQn=true\:5\:0\:false\:false\:true\:true\:false\:true
NVIC1.ETH_IRQn=true\:15\:0\:true\:false\:true\:true\:true\:true
NVIC1.ETH_WKUP_IRQn=true\:15\:0\:true\:false\:true\:true\:true\:true
NVIC1.EXTI3_IRQn=true\:5\:0\:false\:false\:true\:true\:true\:true
NVIC1.I2C1_ER_IRQn=true\:15\:0\:true\:false\:true\:true\:true\:true
NVIC1.I2C1_EV_IRQn=true\:15\:0\:true\:false\:true\:true\:true\:true
NVIC1.I2C2_ER_IRQn=true\:15\:0\:true\:false\:true\:true\:true\:true
NVIC1.I2C2_EV_IRQn=true\:15\:0\:true\:false\:true\:true\:true\:true
NVIC1.I2C3_ER_IRQn=true\:15\:0\:true\:false\:true\:true\:true\:true
NVIC1.I2C4_ER_IRQn=true\:15\:0\:true\:false\:true\:true\:true\:true
NVIC1.OTG_FS_IRQn=true\:5\:0\:false\:false\:true\:true\:false\:true
NVIC1.PriorityGroup=NVIC_PRIORITYGROUP_4
NVIC1.SPI4_IRQn=true\:5\:0\:false\:false\:true\:true\:false\:true
NVIC1.TIM7_IRQn=true\:0\:0\:false\:false\:true\:false\:false\:true
NVIC1.TimeBase=TIM7_IRQn
NVIC1.TimeBaseIP=TIM7
NVIC1.UART4_IRQn=true\:15\:0\:true\:false\:true\:true\:true\:true
NVIC2.PriorityGroup=NVIC_PRIORITYGROUP_4
NVIC2.TIM6_DAC_IRQn=true\:0\:0\:false\:false\:true\:false\:true
NVIC2.TimeBase=TIM6_DAC_IRQn
NVIC2.TimeBaseIP=TIM6
PA0.GPIO_Label=IPM_10
PA0.PinAttribute=CortexM7
PA0.Signal=GPIO_Input
PA1.GPIO_Speed=GPIO_SPEED_FREQ_VERY_HIGH
PA1.Mode=MII
PA1.PinAttribute=CortexM7
PA1.Signal=ETH_RX_CLK
PA10.GPIO_Label=USR_IO_34
PA10.PinAttribute=CortexM7
PA10.Signal=GPIO_Input
PA11.Mode=Device_Only
PA11.PinAttribute=CortexM7
PA11.Signal=USB_OTG_FS_DM
PA12.Mode=Device_Only
PA12.PinAttribute=CortexM7
PA12.Signal=USB_OTG_FS_DP
PA13\ (JTMS/SWDIO).Mode=Serial_Wire
PA13\ (JTMS/SWDIO).PinAttribute=CortexM7
PA13\ (JTMS/SWDIO).Signal=DEBUG_JTMS-SWDIO
PA14\ (JTCK/SWCLK).Mode=Serial_Wire
PA14\ (JTCK/SWCLK).PinAttribute=CortexM7
PA14\ (JTCK/SWCLK).Signal=DEBUG_JTCK-SWCLK
PA2.GPIO_Speed=GPIO_SPEED_FREQ_VERY_HIGH
PA2.Mode=MII
PA2.PinAttribute=CortexM7
PA2.Signal=ETH_MDIO
PA3.GPIO_Label=USR_IO_8
PA3.PinAttribute=CortexM7
PA3.Signal=GPIO_Input
PA4.GPIO_Label=USR_IO_9
PA4.PinAttribute=CortexM7
PA4.Signal=GPIO_Input
PA5.GPIO_Label=USR_IO_5
PA5.PinAttribute=CortexM7
PA5.Signal=GPIO_Input
PA6.GPIO_Label=USR_IO_4
PA6.PinAttribute=CortexM7
PA6.Signal=GPIO_Input
PA7.GPIO_Speed=GPIO_SPEED_FREQ_VERY_HIGH
PA7.Mode=MII
PA7.PinAttribute=CortexM7
PA7.Signal=ETH_RX_DV
PA8.GPIO_PuPd=GPIO_PULLUP
PA8.Mode=I2C
PA8.PinAttribute=CortexM7
PA8.Signal=I2C3_SCL
PB0.GPIO_Label=USR_IO_12
PB0.PinAttribute=CortexM7
PB0.Signal=GPIO_Input
PB1.GPIO_Speed=GPIO_SPEED_FREQ_VERY_HIGH
PB1.Mode=MII
PB1.PinAttribute=CortexM7
PB1.Signal=ETH_RXD3
PB10.GPIO_Label=USR_IO_27
PB10.PinAttribute=CortexM7
PB10.Signal=GPIO_Input
PB11.GPIO_Speed=GPIO_SPEED_FREQ_VERY_HIGH
PB11.Mode=MII
PB11.PinAttribute=CortexM7
PB11.Signal=ETH_TX_EN
PB12.GPIO_Label=HANDLE
PB12.PinAttribute=CortexM7
PB12.Signal=GPIO_Input
PB13.GPIO_Label=PWR_GOOD_B
PB13.PinAttribute=CortexM7
PB13.Signal=GPIO_Input
PB14.GPIO_Label=USR_IO_33
PB14.PinAttribute=CortexM7
PB14.Signal=GPIO_Input
PB15.GPIO_Label=PYLD_RESET
PB15.PinAttribute=CortexM7
PB15.PinState=GPIO_PIN_SET
PB15.Signal=GPIO_Output
PB2.GPIO_Label=USR_IO_14
PB2.PinAttribute=CortexM7
PB2.Signal=GPIO_Input
PB5.GPIO_Label=USR_IO_6
PB5.PinAttribute=CortexM7
PB5.Signal=GPIO_Input
PB6.GPIO_PuPd=GPIO_PULLUP
PB6.Mode=I2C
PB6.PinAttribute=CortexM7
PB6.Signal=I2C1_SCL
PB7.GPIO_PuPd=GPIO_PULLUP
PB7.Mode=I2C
PB7.PinAttribute=CortexM7
PB7.Signal=I2C1_SDA
PB8.GPIO_Speed=GPIO_SPEED_FREQ_VERY_HIGH
PB8.Mode=MII
PB8.PinAttribute=CortexM7
PB8.Signal=ETH_TXD3
PB9.Mode=Asynchronous
PB9.PinAttribute=CortexM7
PB9.Signal=UART4_TX
PC0.GPIO_Label=USR_IO_2
PC0.PinAttribute=CortexM7
PC0.Signal=GPIO_Input
PC1.GPIO_Speed=GPIO_SPEED_FREQ_VERY_HIGH
PC1.Mode=MII
PC1.PinAttribute=CortexM7
PC1.Signal=ETH_MDC
PC13.GPIO_Label=ETH_INT_N
PC13.GPIO_PuPd=GPIO_PULLUP
PC13.PinAttribute=CortexM7
PC13.Signal=GPIO_Input
PC2.GPIO_Speed=GPIO_SPEED_FREQ_VERY_HIGH
PC2.Mode=MII
PC2.PinAttribute=CortexM7
PC2.Signal=ETH_TXD2
PC3.GPIO_Speed=GPIO_SPEED_FREQ_VERY_HIGH
PC3.Mode=MII
PC3.PinAttribute=CortexM7
PC3.Signal=ETH_TX_CLK
PC4.GPIO_Speed=GPIO_SPEED_FREQ_VERY_HIGH
PC4.Mode=MII
PC4.PinAttribute=CortexM7
PC4.Signal=ETH_RXD0
PC5.GPIO_Speed=GPIO_SPEED_FREQ_VERY_HIGH
PC5.Mode=MII
PC5.PinAttribute=CortexM7
PC5.Signal=ETH_RXD1
PC6.GPIO_Label=IPM_8
PC6.PinAttribute=CortexM7
PC6.Signal=GPIO_Input
PC7.GPIO_Label=IPM_13
PC7.PinAttribute=CortexM7
PC7.Signal=GPIO_Input
PC9.GPIO_PuPd=GPIO_PULLUP
PC9.Mode=I2C
PC9.PinAttribute=CortexM7
PC9.Signal=I2C3_SDA
PD10.GPIO_Label=FP_LED_0
PD10.PinAttribute=CortexM7
PD10.PinState=GPIO_PIN_RESET
PD10.Signal=GPIO_Output
PD11.GPIO_Label=EN_12V
PD11.PinAttribute=CortexM7
PD11.PinState=GPIO_PIN_RESET
PD11.Signal=GPIO_Output
PD12.GPIO_Label=FP_LED_2
PD12.PinAttribute=CortexM7
PD12.PinState=GPIO_PIN_RESET
PD12.Signal=GPIO_Output
PD13.GPIO_Label=MASTER_TRST
PD13.PinAttribute=CortexM7
PD13.Signal=GPIO_Input
PD14.GPIO_Label=MASTER_TDO
PD14.PinAttribute=CortexM7
PD14.Signal=GPIO_Input
PD15.GPIO_Label=ALARM_B
PD15.PinAttribute=CortexM7
PD15.Signal=GPIO_Input
PD8.GPIO_Label=FP_LED_BLUE
PD8.PinAttribute=CortexM7
PD8.PinState=GPIO_PIN_RESET
PD8.Signal=GPIO_Output
PD9.GPIO_Label=FP_LED_1
PD9.PinAttribute=CortexM7
PD9.PinState=GPIO_PIN_RESET
PD9.Signal=GPIO_Output
PE0.GPIO_Label=USR_IO_1
PE0.PinAttribute=CortexM7
PE0.Signal=GPIO_Input
PE1.GPIO_Label=USR_IO_0
PE1.PinAttribute=CortexM7
PE1.Signal=GPIO_Input
PE10.GPIO_Label=IPM_11
PE10.PinAttribute=CortexM7
PE10.Signal=GPIO_Input
PE11.GPIO_Label=USR_IO_25
PE11.PinAttribute=CortexM7
PE11.Signal=GPIO_Input
PE12.GPIO_Label=USR_IO_28
PE12.PinAttribute=CortexM7
PE12.Signal=GPIO_Input
PE13.GPIO_Label=USR_IO_24
PE13.PinAttribute=CortexM7
PE13.Signal=GPIO_Input
PE14.GPIO_Label=USR_IO_26
PE14.PinAttribute=CortexM7
PE14.Signal=GPIO_Input
PE15.GPIO_Label=USR_IO_29
PE15.PinAttribute=CortexM7
PE15.Signal=GPIO_Input
PE2.GPIO_PuPd=GPIO_PULLDOWN
PE2.Mode=Full_Duplex_Master
PE2.PinAttribute=CortexM7
PE2.Signal=SPI4_SCK
PE3.GPIO_Label=EXPANDER_RST
PE3.PinAttribute=CortexM7
PE3.PinState=GPIO_PIN_SET
PE3.Signal=GPIO_Output
PE4.GPIO_PuPd=GPIO_PULLUP
PE4.Mode=NSS_Signal_Hard_Output
PE4.PinAttribute=CortexM7
PE4.Signal=SPI4_NSS
PE5.Mode=Full_Duplex_Master
PE5.PinAttribute=CortexM7
PE5.Signal=SPI4_MISO
PE6.Mode=Full_Duplex_Master
PE6.PinAttribute=CortexM7
PE6.Signal=SPI4_MOSI
PE7.GPIO_Label=USR_IO_22
PE7.PinAttribute=CortexM7
PE7.Signal=GPIO_Input
PE8.GPIO_Label=USR_IO_20
PE8.PinAttribute=CortexM7
PE8.Signal=GPIO_Input
PE9.GPIO_Label=USR_IO_23
PE9.PinAttribute=CortexM7
PE9.Signal=GPIO_Input
PF0.GPIO_PuPd=GPIO_PULLUP
PF0.Mode=I2C
PF0.PinAttribute=CortexM7
PF0.Signal=I2C2_SDA
PF1.GPIO_PuPd=GPIO_PULLUP
PF1.Mode=I2C
PF1.PinAttribute=CortexM7
PF1.Signal=I2C2_SCL
PF10.Mode=Single Bank 1
PF10.PinAttribute=CortexM7
PF10.Signal=QUADSPI_CLK
PF11.GPIO_Label=USR_IO_19
PF11.PinAttribute=CortexM7
PF11.Signal=GPIO_Input
PF12.GPIO_Label=USR_IO_18
PF12.PinAttribute=CortexM7
PF12.Signal=GPIO_Input
PF13.GPIO_Label=ALARM_A
PF13.PinAttribute=CortexM7
PF13.Signal=GPIO_Input
PF14.GPIO_PuPd=GPIO_PULLUP
PF14.Mode=I2C
PF14.PinAttribute=CortexM7
PF14.Signal=I2C4_SCL
PF15.GPIO_PuPd=GPIO_PULLUP
PF15.Mode=I2C
PF15.PinAttribute=CortexM7
PF15.Signal=I2C4_SDA
PF2.GPIO_Label=IPM_2
PF2.PinAttribute=CortexM7
PF2.Signal=GPIO_Input
PF3.GPIO_Label=IPM_6
PF3.PinAttribute=CortexM7
PF3.Signal=GPIO_Input
PF4.GPIO_Label=IPM_9
PF4.PinAttribute=CortexM7
PF4.Signal=GPIO_Input
PF5.GPIO_Label=IPM_12
PF5.PinAttribute=CortexM7
PF5.Signal=GPIO_Input
PF6.Mode=Single Bank 1
PF6.PinAttribute=CortexM7
PF6.Signal=QUADSPI_BK1_IO3
PF7.Mode=Single Bank 1
PF7.PinAttribute=CortexM7
PF7.Signal=QUADSPI_BK1_IO2
PF8.Mode=Single Bank 1
PF8.PinAttribute=CortexM7
PF8.Signal=QUADSPI_BK1_IO0
PF9.Mode=Single Bank 1
PF9.PinAttribute=CortexM7
PF9.Signal=QUADSPI_BK1_IO1
PG0.GPIO_Label=USR_IO_21
PG0.PinAttribute=CortexM7
PG0.Signal=GPIO_Input
PG1.GPIO_Label=USR_IO_17
PG1.PinAttribute=CortexM7
PG1.Signal=GPIO_Input
PG12.GPIO_Speed=GPIO_SPEED_FREQ_VERY_HIGH
PG12.Mode=MII
PG12.PinAttribute=CortexM7
PG12.Signal=ETH_TXD1
PG13.GPIO_Speed=GPIO_SPEED_FREQ_VERY_HIGH
PG13.Mode=MII
PG13.PinAttribute=CortexM7
PG13.Signal=ETH_TXD0
PG14.GPIO_Label=IPM_14
PG14.PinAttribute=CortexM7
PG14.Signal=GPIO_Input
PG2.GPIO_Label=IPMB_A_EN
PG2.PinAttribute=CortexM7
PG2.PinState=GPIO_PIN_RESET
PG2.Signal=GPIO_Output
PG3.GPIO_Label=IPMB_B_RDY
PG3.GPIO_PuPd=GPIO_PULLUP
PG3.PinAttribute=CortexM7
PG3.Signal=GPIO_Input
PG4.GPIO_Label=IPMB_B_EN
PG4.PinAttribute=CortexM7
PG4.Signal=GPIO_Output
PG5.GPIO_Label=IPM_7
PG5.PinAttribute=CortexM7
PG5.Signal=GPIO_Input
PG6.Mode=Single Bank 1
PG6.PinAttribute=CortexM7
PG6.Signal=QUADSPI_BK1_NCS
PG8.GPIO_Label=USR_IO_7
PG8.PinAttribute=CortexM7
PG8.Signal=GPIO_Input
PH0-OSC_IN\ (PH0).Mode=HSE-External-Oscillator
PH0-OSC_IN\ (PH0).PinAttribute=CortexM7
PH0-OSC_IN\ (PH0).Signal=RCC_OSC_IN
PH1-OSC_OUT\ (PH1).Mode=HSE-External-Oscillator
PH1-OSC_OUT\ (PH1).PinAttribute=CortexM7
PH1-OSC_OUT\ (PH1).Signal=RCC_OSC_OUT
PH10.GPIO_Label=HW_2
PH10.GPIO_PuPd=GPIO_PULLUP
PH10.PinAttribute=CortexM7
PH10.Signal=GPIO_Input
PH11.GPIO_Label=MASTER_TCK
PH11.PinAttribute=CortexM7
PH11.Signal=GPIO_Input
PH12.GPIO_Label=PWR_GOOD_A
PH12.PinAttribute=CortexM7
PH12.Signal=GPIO_Input
PH14.GPIO_PuPd=GPIO_PULLUP
PH14.Mode=Asynchronous
PH14.PinAttribute=CortexM7
PH14.Signal=UART4_RX
PH2.GPIO_Speed=GPIO_SPEED_FREQ_VERY_HIGH
PH2.Mode=MII
PH2.PinAttribute=CortexM7
PH2.Signal=ETH_CRS
PH3.GPIO_Speed=GPIO_SPEED_FREQ_VERY_HIGH
PH3.Mode=MII
PH3.PinAttribute=CortexM7
PH3.Signal=ETH_COL
PH4.GPIO_Label=USR_IO_3
PH4.PinAttribute=CortexM7
PH4.Signal=GPIO_Input
PH5.GPIO_Label=ETH_TX_ER
PH5.PinAttribute=CortexM7
PH5.Signal=GPIO_Output
PH6.GPIO_Speed=GPIO_SPEED_FREQ_VERY_HIGH
PH6.Mode=MII
PH6.PinAttribute=CortexM7
PH6.Signal=ETH_RXD2
PH7.GPIO_Label=USR_IO_30
PH7.PinAttribute=CortexM7
PH7.Signal=GPIO_Input
PH8.GPIO_Label=USR_IO_32
PH8.PinAttribute=CortexM7
PH8.Signal=GPIO_Input
PH9.GPIO_Label=HW_0
PH9.GPIO_PuPd=GPIO_PULLUP
PH9.PinAttribute=CortexM7
PH9.Signal=GPIO_Input
PI10.GPIO_Speed=GPIO_SPEED_FREQ_VERY_HIGH
PI10.Mode=Activate Rx Err signal
PI10.PinAttribute=CortexM7
PI10.Signal=ETH_RX_ER
PI12.GPIO_Label=IPM_3
PI12.PinAttribute=CortexM7
PI12.Signal=GPIO_Input
PI13.GPIO_Label=IPM_4
PI13.PinAttribute=CortexM7
PI13.Signal=GPIO_Input
PI14.GPIO_Label=IPM_5
PI14.PinAttribute=CortexM7
PI14.Signal=GPIO_Input
PI15.GPIO_Label=USR_IO_10
PI15.PinAttribute=CortexM7
PI15.Signal=GPIO_Input
PI3.GPIO_Label=EXPANDER_INT
PI3.GPIO_ModeDefaultEXTI=GPIO_MODE_IT_FALLING
PI3.GPIO_PuPd=GPIO_PULLUP
PI3.PinAttribute=CortexM7
PI3.Signal=GPXTI3
PI4.GPIO_Label=IPM_0
PI4.PinAttribute=CortexM7
PI4.Signal=GPIO_Input
PI5.GPIO_Label=I2C_BB_SDA
PI5.GPIO_PuPd=GPIO_PULLUP
PI5.PinAttribute=CortexM7
PI5.Signal=GPIO_Input
PI6.GPIO_Label=I2C_BB_SCL
PI6.GPIO_PuPd=GPIO_PULLUP
PI6.PinAttribute=CortexM7
PI6.Signal=GPIO_Input
PI7.GPIO_Label=IPM_1
PI7.PinAttribute=CortexM7
PI7.Signal=GPIO_Input
PI8.GPIO_Label=ETH_RST_N
PI8.PinAttribute=CortexM7
PI8.PinState=GPIO_PIN_SET
PI8.Signal=GPIO_Output
PJ0.GPIO_Label=IPM_15
PJ0.PinAttribute=CortexM7
PJ0.Signal=GPIO_Input
PJ1.GPIO_Label=USR_IO_11
PJ1.PinAttribute=CortexM7
PJ1.Signal=GPIO_Input
PJ10.GPIO_Label=HW_1
PJ10.GPIO_PuPd=GPIO_PULLUP
PJ10.PinAttribute=CortexM7
PJ10.Signal=GPIO_Input
PJ11.GPIO_Label=HW_3
PJ11.GPIO_PuPd=GPIO_PULLUP
PJ11.PinAttribute=CortexM7
PJ11.Signal=GPIO_Input
PJ2.GPIO_Label=USR_IO_15
PJ2.PinAttribute=CortexM7
PJ2.Signal=GPIO_Input
PJ3.GPIO_Label=USR_IO_13
PJ3.PinAttribute=CortexM7
PJ3.Signal=GPIO_Input
PJ4.GPIO_Label=USR_IO_16
PJ4.PinAttribute=CortexM7
PJ4.Signal=GPIO_Input
PJ5.GPIO_Label=USR_IO_31
PJ5.PinAttribute=CortexM7
PJ5.Signal=GPIO_Input
PJ6.GPIO_Label=MASTER_TMS
PJ6.PinAttribute=CortexM7
PJ6.Signal=GPIO_Input
PJ7.GPIO_Label=MASTER_TDI
PJ7.PinAttribute=CortexM7
PJ7.Signal=GPIO_Input
PJ8.GPIO_Label=HW_4
PJ8.GPIO_PuPd=GPIO_PULLUP
PJ8.PinAttribute=CortexM7
PJ8.Signal=GPIO_Input
PJ9.GPIO_Label=HW_6
PJ9.GPIO_PuPd=GPIO_PULLUP
PJ9.PinAttribute=CortexM7
PJ9.Signal=GPIO_Input
PK0.GPIO_Label=HW_5
PK0.GPIO_PuPd=GPIO_PULLUP
PK0.PinAttribute=CortexM7
PK0.Signal=GPIO_Input
PK1.GPIO_Label=HW_7
PK1.GPIO_PuPd=GPIO_PULLUP
PK1.PinAttribute=CortexM7
PK1.Signal=GPIO_Input
PK2.GPIO_Label=IPMB_A_RDY
PK2.GPIO_PuPd=GPIO_PULLUP
PK2.PinAttribute=CortexM7
PK2.Signal=GPIO_Input
ProjectManager.HeapSize=0x200
ProjectManager.StackSize=0x400
ProjectManager.TargetToolchain=STM32CubeIDE
QUADSPI.FlashSize=31
RCC.ADCFreq_Value=50390625
RCC.APB1Freq_Value=100000000
RCC.APB2Freq_Value=100000000
RCC.APB3Freq_Value=100000000
RCC.APB4Freq_Value=100000000
RCC.CortexFreq_Value=200000000
RCC.DIVM1=2
RCC.DIVN1=32
RCC.HCLKFreq_Value=100000000
RCC.HPRE=RCC_HCLK_DIV2
RCC.PLLFRACN=0
RCC.PLLSourceVirtual=RCC_PLLSOURCE_HSE
RCC.SYSCLKFreq_VALUE=200000000
RCC.SYSCLKSource=RCC_SYSCLKSOURCE_PLLCLK
RCC.SupplySource=PWR_SMPS_1V8_SUPPLIES_LDO
RCC.USBCLockSelection=RCC_USBCLKSOURCE_HSI48
RCC.USBFreq_Value=48000000
SPI4.BaudRatePrescaler=SPI_BAUDRATEPRESCALER_16
SPI4.CLKPhase=SPI_PHASE_1EDGE
SPI4.CLKPolarity=SPI_POLARITY_LOW
SPI4.CalculateBaudRate=6.25 MBits/s
SPI4.DataSize=SPI_DATASIZE_8BIT
SPI4.Direction=SPI_DIRECTION_2LINES
SPI4.Mode=SPI_MODE_MASTER
SPI4.VirtualNSS=VM_NSSHARD
SPI4.VirtualType=VM_MASTER
SYS.userName=SYS_M7
USB_DEVICE_M7.CLASS_NAME_FS=CDC
USB_DEVICE_M7.VirtualMode-CDC_FS=Cdc
USB_DEVICE_M7.VirtualModeFS=Cdc_FS
USB_OTG_FS.VirtualMode=Device_Only
VP_CRC_VS_CRC.Mode=CRC_Activate
VP_FREERTOS_M7_VS_CMSIS_V2.Mode=CMSIS_V2
VP_LWIP_VS_Enabled.Mode=Enabled
VP_SYS_M4_VS_tim6.Mode=TIM6
VP_SYS_VS_tim7.Mode=TIM7
VP_USB_DEVICE_M7_VS_USB_DEVICE_CDC_FS.Mode=CDC_FS
board=custom

// file: CM7/Core/Src/main.c
/* USER CODE BEGIN Header */
/**
  ******************************************************************************
  * @file           : main.c
  * @brief          : Main program body
  ******************************************************************************
  * @attention
  *
  * <h2><center>&copy; Copyright (c) 2020 STMicroelectronics.
  * All rights reserved.</center></h2>
  *
  * This software component is licensed by ST under BSD 3-Clause license,
  * the "License"; You may not use this file except in compliance with the
  * License. You may obtain a copy of the License at:
  *                        opensource.org/licenses/BSD-3-Clause
  *
  ******************************************************************************
  */
/* USER CODE END Header */
#include "main.h"
#include "cmsis_os.h"
#include "lwip.h"
#include "usb_device.h"

/* USER CODE BEGIN Includes */
#include "string.h"
#include "stream_buffer.h"
#include "dimm_gpios.h"
#include "amc_gpios.h"
#include "printf.h"
#include "ipmc_tasks.h"
#include "udp.h"
#include "ipmc_ios.h"
#include "fru_state_machine.h"
#include "ipmb_0.h"
#include "amc_gpios.h"
#include "mgm_i2c.h"
#include "sense_i2c.h"
#include "network_ctrls.h"
#include "telnet_server.h"
#include "apollo/apollo.h"
#include "printf.h"
#include "usbd_cdc_if.h"
#include "fw_metadata.h"

/* USER CODE END Includes */

/* USER CODE BEGIN PD */

#ifndef HSEM_ID_0
#define HSEM_ID_0 (0U) /* HW semaphore 0*/
#endif
/* USER CODE END PD */

CRC_HandleTypeDef hcrc;

I2C_HandleTypeDef hi2c1;
I2C_HandleTypeDef hi2c2;
I2C_HandleTypeDef hi2c3;
I2C_HandleTypeDef hi2c4;

QSPI_HandleTypeDef hqspi;

SPI_HandleTypeDef hspi4;
DMA_HandleTypeDef hdma_spi4_tx;
DMA_HandleTypeDef hdma_spi4_rx;

UART_HandleTypeDef huart4;

/* Definitions for defaultTask */
osThreadId_t defaultTaskHandle;
const osThreadAttr_t defaultTask_attributes = {
  .name = "defaultTask",
  .priority = (osPriority_t) osPriorityNormal,
  .stack_size = 512 * 4
};
/* USER CODE BEGIN PV */

osThreadId_t terminal_input_task_handle;
const osThreadAttr_t terminal_input_task_attributes = {
  .name = "TerminalInputTask",
  .priority = (osPriority_t) osPriorityNormal,
  .stack_size = 200* 4
};

osThreadId_t terminal_process_task_handle;
const osThreadAttr_t terminal_process_task_attributes = {
  .name = "TerminalProcessTask",
  .priority = (osPriority_t) osPriorityNormal,
  .stack_size = (256+256) * 4
};

osThreadId_t ipmb_0_msg_receiver_task_handle;
const osThreadAttr_t ipmb_0_msg_receiver_task_attributes = {
  .name = "MNG",
  .priority = (osPriority_t) osPriorityNormal3,
  .stack_size = 512 * 4
};

osThreadId_t ipmb_0_msg_sender_task_handle;
const osThreadAttr_t ipmb_0_msg_sender_task_attributes = {
  .name = "MNGO",
  .priority = (osPriority_t) osPriorityNormal1,
  .stack_size = 512 * 4
};

osThreadId_t fru_state_machine_task_handle;
const osThreadAttr_t fru_state_machine_task_attributes = {
  .name = "SMM",
  .priority = (osPriority_t) osPriorityNormal1,
  .stack_size = 512 * 4
};

osThreadId_t ipmi_incoming_requests_manager_task_handle;
const osThreadAttr_t ipmi_incoming_requests_manager_task_attributes = {
  .name = "IPMI_MSG_MGMT",
  .priority = (osPriority_t) osPriorityNormal2,
  .stack_size = 512 * 4
};

osThreadId_t ipmc_handle_switch_task_handle;
const osThreadAttr_t ipmc_handle_switch_task_attributes = {
  .name = "IPMC_HANDLE_TRANS",
  .priority = (osPriority_t) osPriorityNormal2,
  .stack_size = 128 * 4
};

osThreadId_t ipmc_blue_led_blink_task_handle;
const osThreadAttr_t ipmc_blue_led_blink_task_attributes = {
  .name = "BLUE_LED",
  .priority = (osPriority_t) osPriorityNormal2,
  .stack_size = 128 * 4
};

void ipmc_fp_led_blink_task( void *argument );
osThreadId_t ipmc_fp_led_blink_task_handle;
const osThreadAttr_t ipmc_fp_led_blink_task_attributes = {
  .name = "FP_LED",
  .priority = (osPriority_t) osPriorityNormal2,
  .stack_size = 128 * 4
};

osThreadId_t vcp_output_task_handle;
const osThreadAttr_t vcp_output_task_attributes = {
  .name = "VcpOutputTask",
  .priority = (osPriority_t) osPriorityNormal,
  .stack_size = 64 * 4
};

osThreadId_t hpm1_upgrade_task_handle;
const osThreadAttr_t hpm1_upgrade_task_attributes = {
  .name = "HPM1UpgradeTask",
  .priority = (osPriority_t) osPriorityLow,
  .stack_size = 512 * 4
};

// Telnet instance handler for CLI
telnet_t telnet23;

// Text IO
static char uart4_input_char;
static SemaphoreHandle_t printf_mutex = NULL;
static StaticSemaphore_t printf_mutex_buffer;
extern StreamBufferHandle_t terminal_input_stream;
static StreamBufferHandle_t vcp_output_stream = NULL;

/* USER CODE END PV */

void SystemClock_Config(void);
static void MPU_Config(void);
static void MX_GPIO_Init(void);
static void MX_DMA_Init(void);
static void MX_UART4_Init(void);
static void MX_I2C1_Init(void);
static void MX_I2C2_Init(void);
static void MX_SPI4_Init(void);
static void MX_I2C4_Init(void);
static void MX_I2C3_Init(void);
static void MX_CRC_Init(void);
static void MX_QUADSPI_Init(void);
void StartDefaultTask(void *argument);

/* USER CODE BEGIN PFP */
extern void    terminal_input_task(void *argument);
extern void    terminal_process_task(void *argument);
extern void    openipmc_hal_init( void );
extern uint8_t get_haddress_pins( void );
extern void    set_benchtop_payload_power_level( uint8_t new_power_level );
void mt_vprintf(const char* format, va_list va);
static void    vcp_output_task(void *argument);

/* USER CODE END PFP */

int main(void)
{
/* USER CODE BEGIN Boot_Mode_Sequence_0 */
  int32_t timeout;

/* USER CODE END Boot_Mode_Sequence_0 */

  /* MPU Configuration--------------------------------------------------------*/
  MPU_Config();

  /* Enable I-Cache---------------------------------------------------------*/
  SCB_EnableICache();

  /* Enable D-Cache---------------------------------------------------------*/
  SCB_EnableDCache();

/* USER CODE BEGIN Boot_Mode_Sequence_1 */
  /* Wait until CPU2 boots and enters in stop mode or timeout*/
  timeout = 0xFFFF;
  while((__HAL_RCC_GET_FLAG(RCC_FLAG_D2CKRDY) != RESET) && (timeout-- > 0));
  if ( timeout < 0 )
  {
  Error_Handler();
  }
/* USER CODE END Boot_Mode_Sequence_1 */
  /* MCU Configuration--------------------------------------------------------*/

  /* Reset of all peripherals, Initializes the Flash interface and the Systick. */
  HAL_Init();

  /* Configure the system clock */
  SystemClock_Config();
/* USER CODE BEGIN Boot_Mode_Sequence_2 */
/* When system initialization is finished, Cortex-M7 will release Cortex-M4 by means of
HSEM notification */
/*HW semaphore Clock enable*/
__HAL_RCC_HSEM_CLK_ENABLE();
/*Take HSEM */
HAL_HSEM_FastTake(HSEM_ID_0);
/*Release HSEM in order to notify the CPU2(CM4)*/
HAL_HSEM_Release(HSEM_ID_0,0);
/* wait until CPU2 wakes up from stop mode */
timeout = 0xFFFF;
while((__HAL_RCC_GET_FLAG(RCC_FLAG_D2CKRDY) == RESET) && (timeout-- > 0));
if ( timeout < 0 )
{
Error_Handler();
}
/* USER CODE END Boot_Mode_Sequence_2 */

  /* Initialize all configured peripherals */
  MX_GPIO_Init();
  MX_DMA_Init();
  MX_UART4_Init();
  MX_I2C1_Init();
  MX_I2C2_Init();
  MX_SPI4_Init();
  MX_I2C4_Init();
  MX_I2C3_Init();
  MX_CRC_Init();
  MX_QUADSPI_Init();

  /* Init scheduler */
  osKernelInitialize();

  /* USER CODE BEGIN RTOS_MUTEX */
  printf_mutex = xSemaphoreCreateMutexStatic( &printf_mutex_buffer );
  /* USER CODE END RTOS_MUTEX */

  /* Create the thread(s) */
  /* creation of defaultTask */
  defaultTaskHandle = osThreadNew(StartDefaultTask, NULL, &defaultTask_attributes);

  /* USER CODE BEGIN RTOS_THREADS */
  terminal_input_task_handle = osThreadNew(terminal_input_task, NULL, &terminal_input_task_attributes);
  terminal_process_task_handle = osThreadNew(terminal_process_task, NULL, &terminal_process_task_attributes);
  ipmb_0_msg_receiver_task_handle = osThreadNew(ipmb_0_msg_receiver_task, NULL, &ipmb_0_msg_receiver_task_attributes);
  ipmb_0_msg_sender_task_handle = osThreadNew(ipmb_0_msg_sender_task, NULL, &ipmb_0_msg_sender_task_attributes);
  fru_state_machine_task_handle = osThreadNew(fru_state_machine_task, NULL, &fru_state_machine_task_attributes);
  ipmi_incoming_requests_manager_task_handle = osThreadNew(ipmi_incoming_requests_manager_task, NULL, &ipmi_incoming_requests_manager_task_attributes);
  ipmc_handle_switch_task_handle = osThreadNew(ipmc_handle_switch_task, NULL, &ipmc_handle_switch_task_attributes);
  ipmc_blue_led_blink_task_handle = osThreadNew(ipmc_blue_led_blink_task, NULL, &ipmc_blue_led_blink_task_attributes);
  ipmc_fp_led_blink_task_handle = osThreadNew(ipmc_fp_led_blink_task, NULL, &ipmc_fp_led_blink_task_attributes);
  vcp_output_task_handle = osThreadNew(vcp_output_task, NULL, &vcp_output_task_attributes);
  hpm1_upgrade_task_handle = osThreadNew(hpm1_upgrade_task, NULL, &hpm1_upgrade_task_attributes);

  /* USER CODE END RTOS_THREADS */

  /* Start scheduler */
  osKernelStart();

  /* We should never get here as control is now taken by the scheduler */
  /* Infinite loop */
  while (1)
  {

  }
}

void SystemClock_Config(void)
{
  RCC_OscInitTypeDef RCC_OscInitStruct = {0};
  RCC_ClkInitTypeDef RCC_ClkInitStruct = {0};
  RCC_PeriphCLKInitTypeDef PeriphClkInitStruct = {0};

  /** Supply configuration update enable
  */
  HAL_PWREx_ConfigSupply(PWR_SMPS_1V8_SUPPLIES_LDO);
  /** Configure the main internal regulator output voltage
  */
  __HAL_PWR_VOLTAGESCALING_CONFIG(PWR_REGULATOR_VOLTAGE_SCALE3);

  while(!__HAL_PWR_GET_FLAG(PWR_FLAG_VOSRDY)) {}
  /** Initializes the RCC Oscillators according to the specified parameters
  * in the RCC_OscInitTypeDef structure.
  */
  RCC_OscInitStruct.OscillatorType = RCC_OSCILLATORTYPE_HSI48|RCC_OSCILLATORTYPE_HSE;
  RCC_OscInitStruct.HSEState = RCC_HSE_ON;
  RCC_OscInitStruct.HSI48State = RCC_HSI48_ON;
  RCC_OscInitStruct.PLL.PLLState = RCC_PLL_ON;
  RCC_OscInitStruct.PLL.PLLSource = RCC_PLLSOURCE_HSE;
  RCC_OscInitStruct.PLL.PLLM = 2;
  RCC_OscInitStruct.PLL.PLLN = 32;
  RCC_OscInitStruct.PLL.PLLP = 2;
  RCC_OscInitStruct.PLL.PLLQ = 2;
  RCC_OscInitStruct.PLL.PLLR = 2;
  RCC_OscInitStruct.PLL.PLLRGE = RCC_PLL1VCIRANGE_3;
  RCC_OscInitStruct.PLL.PLLVCOSEL = RCC_PLL1VCOWIDE;
  RCC_OscInitStruct.PLL.PLLFRACN = 0;
  if (HAL_RCC_OscConfig(&RCC_OscInitStruct) != HAL_OK)
  {
    Error_Handler();
  }
  /** Initializes the CPU, AHB and APB buses clocks
  */
  RCC_ClkInitStruct.ClockType = RCC_CLOCKTYPE_HCLK|RCC_CLOCKTYPE_SYSCLK
                              |RCC_CLOCKTYPE_PCLK1|RCC_CLOCKTYPE_PCLK2
                              |RCC_CLOCKTYPE_D3PCLK1|RCC_CLOCKTYPE_D1PCLK1;
  RCC_ClkInitStruct.SYSCLKSource = RCC_SYSCLKSOURCE_PLLCLK;
  RCC_ClkInitStruct.SYSCLKDivider = RCC_SYSCLK_DIV1;
  RCC_ClkInitStruct.AHBCLKDivider = RCC_HCLK_DIV2;
  RCC_ClkInitStruct.APB3CLKDivider = RCC_APB3_DIV1;
  RCC_ClkInitStruct.APB1CLKDivider = RCC_APB1_DIV1;
  RCC_ClkInitStruct.APB2CLKDivider = RCC_APB2_DIV1;
  RCC_ClkInitStruct.APB4CLKDivider = RCC_APB4_DIV1;

  if (HAL_RCC_ClockConfig(&RCC_ClkInitStruct, FLASH_LATENCY_1) != HAL_OK)
  {
    Error_Handler();
  }
  PeriphClkInitStruct.PeriphClockSelection = RCC_PERIPHCLK_UART4|RCC_PERIPHCLK_SPI4
                              |RCC_PERIPHCLK_I2C2|RCC_PERIPHCLK_I2C3
                              |RCC_PERIPHCLK_I2C1|RCC_PERIPHCLK_I2C4
                              |RCC_PERIPHCLK_USB|RCC_PERIPHCLK_QSPI;
  PeriphClkInitStruct.QspiClockSelection = RCC_QSPICLKSOURCE_D1HCLK;
  PeriphClkInitStruct.Spi45ClockSelection = RCC_SPI45CLKSOURCE_D2PCLK1;
  PeriphClkInitStruct.Usart234578ClockSelection = RCC_USART234578CLKSOURCE_D2PCLK1;
  PeriphClkInitStruct.I2c123ClockSelection = RCC_I2C123CLKSOURCE_D2PCLK1;
  PeriphClkInitStruct.UsbClockSelection = RCC_USBCLKSOURCE_HSI48;
  PeriphClkInitStruct.I2c4ClockSelection = RCC_I2C4CLKSOURCE_D3PCLK1;
  if (HAL_RCCEx_PeriphCLKConfig(&PeriphClkInitStruct) != HAL_OK)
  {
    Error_Handler();
  }
  /** Enable USB Voltage detector
  */
  HAL_PWREx_EnableUSBVoltageDetector();
}

static void MX_CRC_Init(void)
{

  hcrc.Instance = CRC;
  hcrc.Init.DefaultPolynomialUse = DEFAULT_POLYNOMIAL_ENABLE;
  hcrc.Init.DefaultInitValueUse = DEFAULT_INIT_VALUE_ENABLE;
  hcrc.Init.InputDataInversionMode = CRC_INPUTDATA_INVERSION_BYTE;
  hcrc.Init.OutputDataInversionMode = CRC_OUTPUTDATA_INVERSION_ENABLE;
  hcrc.InputDataFormat = CRC_INPUTDATA_FORMAT_BYTES;
  if (HAL_CRC_Init(&hcrc) != HAL_OK)
  {
    Error_Handler();
  }

}

static void MX_I2C1_Init(void)
{

  hi2c1.Instance = I2C1;
  hi2c1.Init.Timing = 0x10C0ECFF;
  hi2c1.Init.OwnAddress1 = 0;
  hi2c1.Init.AddressingMode = I2C_ADDRESSINGMODE_7BIT;
  hi2c1.Init.DualAddressMode = I2C_DUALADDRESS_DISABLE;
  hi2c1.Init.OwnAddress2 = 0;
  hi2c1.Init.OwnAddress2Masks = I2C_OA2_NOMASK;
  hi2c1.Init.GeneralCallMode = I2C_GENERALCALL_DISABLE;
  hi2c1.Init.NoStretchMode = I2C_NOSTRETCH_ENABLE;
  if (HAL_I2C_Init(&hi2c1) != HAL_OK)
  {
    Error_Handler();
  }
  /** Configure Analogue filter
  */
  if (HAL_I2CEx_ConfigAnalogFilter(&hi2c1, I2C_ANALOGFILTER_ENABLE) != HAL_OK)
  {
    Error_Handler();
  }
  /** Configure Digital filter
  */
  if (HAL_I2CEx_ConfigDigitalFilter(&hi2c1, 0) != HAL_OK)
  {
    Error_Handler();
  }

}

static void MX_I2C2_Init(void)
{

  hi2c2.Instance = I2C2;
  hi2c2.Init.Timing = 0x10C0ECFF;
  hi2c2.Init.OwnAddress1 = 0;
  hi2c2.Init.AddressingMode = I2C_ADDRESSINGMODE_7BIT;
  hi2c2.Init.DualAddressMode = I2C_DUALADDRESS_DISABLE;
  hi2c2.Init.OwnAddress2 = 0;
  hi2c2.Init.OwnAddress2Masks = I2C_OA2_NOMASK;
  hi2c2.Init.GeneralCallMode = I2C_GENERALCALL_DISABLE;
  hi2c2.Init.NoStretchMode = I2C_NOSTRETCH_ENABLE;
  if (HAL_I2C_Init(&hi2c2) != HAL_OK)
  {
    Error_Handler();
  }
  /** Configure Analogue filter
  */
  if (HAL_I2CEx_ConfigAnalogFilter(&hi2c2, I2C_ANALOGFILTER_ENABLE) != HAL_OK)
  {
    Error_Handler();
  }
  /** Configure Digital filter
  */
  if (HAL_I2CEx_ConfigDigitalFilter(&hi2c2, 0) != HAL_OK)
  {
    Error_Handler();
  }

}

static void MX_I2C3_Init(void)
{

  hi2c3.Instance = I2C3;
  hi2c3.Init.Timing = 0x10C0ECFF;
  hi2c3.Init.OwnAddress1 = 0;
  hi2c3.Init.AddressingMode = I2C_ADDRESSINGMODE_7BIT;
  hi2c3.Init.DualAddressMode = I2C_DUALADDRESS_DISABLE;
  hi2c3.Init.OwnAddress2 = 0;
  hi2c3.Init.OwnAddress2Masks = I2C_OA2_NOMASK;
  hi2c3.Init.GeneralCallMode = I2C_GENERALCALL_DISABLE;
  hi2c3.Init.NoStretchMode = I2C_NOSTRETCH_ENABLE;
  if (HAL_I2C_Init(&hi2c3) != HAL_OK)
  {
    Error_Handler();
  }
  /** Configure Analogue filter
  */
  if (HAL_I2CEx_ConfigAnalogFilter(&hi2c3, I2C_ANALOGFILTER_ENABLE) != HAL_OK)
  {
    Error_Handler();
  }
  /** Configure Digital filter
  */
  if (HAL_I2CEx_ConfigDigitalFilter(&hi2c3, 0) != HAL_OK)
  {
    Error_Handler();
  }

}

static void MX_I2C4_Init(void)
{

  hi2c4.Instance = I2C4;
  hi2c4.Init.Timing = 0x90204DFD;
  hi2c4.Init.OwnAddress1 = 0;
  hi2c4.Init.AddressingMode = I2C_ADDRESSINGMODE_7BIT;
  hi2c4.Init.DualAddressMode = I2C_DUALADDRESS_DISABLE;
  hi2c4.Init.OwnAddress2 = 0;
  hi2c4.Init.OwnAddress2Masks = I2C_OA2_NOMASK;
  hi2c4.Init.GeneralCallMode = I2C_GENERALCALL_DISABLE;
  hi2c4.Init.NoStretchMode = I2C_NOSTRETCH_ENABLE;

  if (HAL_I2C_Init(&hi2c4) != HAL_OK)
  {
    Error_Handler();
  }
  /** Configure Analogue filter
  */
  if (HAL_I2CEx_ConfigAnalogFilter(&hi2c4, I2C_ANALOGFILTER_ENABLE) != HAL_OK)
  {
    Error_Handler();
  }
  /** Configure Digital filter
  */
  if (HAL_I2CEx_ConfigDigitalFilter(&hi2c4, 0) != HAL_OK)
  {
    Error_Handler();
  }

}

static void MX_QUADSPI_Init(void)
{

  /* QUADSPI parameter configuration*/
  hqspi.Instance = QUADSPI;
  hqspi.Init.ClockPrescaler = 255;
  hqspi.Init.FifoThreshold = 1;
  hqspi.Init.SampleShifting = QSPI_SAMPLE_SHIFTING_NONE;
  hqspi.Init.FlashSize = 31;
  hqspi.Init.ChipSelectHighTime = QSPI_CS_HIGH_TIME_1_CYCLE;
  hqspi.Init.ClockMode = QSPI_CLOCK_MODE_0;
  hqspi.Init.FlashID = QSPI_FLASH_ID_1;
  hqspi.Init.DualFlash = QSPI_DUALFLASH_DISABLE;
  if (HAL_QSPI_Init(&hqspi) != HAL_OK)
  {
    Error_Handler();
  }

}

static void MX_SPI4_Init(void)
{

  /* SPI4 parameter configuration*/
  hspi4.Instance = SPI4;
  hspi4.Init.Mode = SPI_MODE_MASTER;
  hspi4.Init.Direction = SPI_DIRECTION_2LINES;
  hspi4.Init.DataSize = SPI_DATASIZE_8BIT;
  hspi4.Init.CLKPolarity = SPI_POLARITY_LOW;
  hspi4.Init.CLKPhase = SPI_PHASE_1EDGE;
  hspi4.Init.NSS = SPI_NSS_HARD_OUTPUT;
  hspi4.Init.BaudRatePrescaler = SPI_BAUDRATEPRESCALER_16;
  hspi4.Init.FirstBit = SPI_FIRSTBIT_MSB;
  hspi4.Init.TIMode = SPI_TIMODE_DISABLE;
  hspi4.Init.CRCCalculation = SPI_CRCCALCULATION_DISABLE;
  hspi4.Init.CRCPolynomial = 0x0;
  hspi4.Init.NSSPMode = SPI_NSS_PULSE_ENABLE;
  hspi4.Init.NSSPolarity = SPI_NSS_POLARITY_LOW;
  hspi4.Init.FifoThreshold = SPI_FIFO_THRESHOLD_01DATA;
  hspi4.Init.TxCRCInitializationPattern = SPI_CRC_INITIALIZATION_ALL_ZERO_PATTERN;
  hspi4.Init.RxCRCInitializationPattern = SPI_CRC_INITIALIZATION_ALL_ZERO_PATTERN;
  hspi4.Init.MasterSSIdleness = SPI_MASTER_SS_IDLENESS_00CYCLE;
  hspi4.Init.MasterInterDataIdleness = SPI_MASTER_INTERDATA_IDLENESS_00CYCLE;
  hspi4.Init.MasterReceiverAutoSusp = SPI_MASTER_RX_AUTOSUSP_DISABLE;
  hspi4.Init.MasterKeepIOState = SPI_MASTER_KEEP_IO_STATE_DISABLE;
  hspi4.Init.IOSwap = SPI_IO_SWAP_DISABLE;
  if (HAL_SPI_Init(&hspi4) != HAL_OK)
  {
    Error_Handler();
  }

}

static void MX_UART4_Init(void)
{

  huart4.Instance = UART4;
  huart4.Init.BaudRate = 115200;
  huart4.Init.WordLength = UART_WORDLENGTH_8B;
  huart4.Init.StopBits = UART_STOPBITS_1;
  huart4.Init.Parity = UART_PARITY_NONE;
  huart4.Init.Mode = UART_MODE_TX_RX;
  huart4.Init.HwFlowCtl = UART_HWCONTROL_NONE;
  huart4.Init.OverSampling = UART_OVERSAMPLING_16;
  huart4.Init.OneBitSampling = UART_ONE_BIT_SAMPLE_DISABLE;
  huart4.Init.ClockPrescaler = UART_PRESCALER_DIV1;
  huart4.AdvancedInit.AdvFeatureInit = UART_ADVFEATURE_NO_INIT;
  if (HAL_UART_Init(&huart4) != HAL_OK)
  {
    Error_Handler();
  }
  if (HAL_UARTEx_SetTxFifoThreshold(&huart4, UART_TXFIFO_THRESHOLD_1_8) != HAL_OK)
  {
    Error_Handler();
  }
  if (HAL_UARTEx_SetRxFifoThreshold(&huart4, UART_RXFIFO_THRESHOLD_1_8) != HAL_OK)
  {
    Error_Handler();
  }
  if (HAL_UARTEx_DisableFifoMode(&huart4) != HAL_OK)
  {
    Error_Handler();
  }
  /* USER CODE BEGIN UART4_Init 2 */

  // Immediately starts the reception
  // Commented out to disable UART0, which was crashing the system with spam from the zynq
  //HAL_UART_Receive_IT(&huart4, (uint8_t*)(&uart4_input_char), 1);

  /* USER CODE END UART4_Init 2 */

}

static void MX_DMA_Init(void)
{

  /* DMA controller clock enable */
  __HAL_RCC_DMA1_CLK_ENABLE();

  /* DMA interrupt init */
  /* DMA1_Stream0_IRQn interrupt configuration */
  HAL_NVIC_SetPriority(DMA1_Stream0_IRQn, 5, 0);
  HAL_NVIC_EnableIRQ(DMA1_Stream0_IRQn);
  /* DMA1_Stream1_IRQn interrupt configuration */
  HAL_NVIC_SetPriority(DMA1_Stream1_IRQn, 5, 0);
  HAL_NVIC_EnableIRQ(DMA1_Stream1_IRQn);

}

static void MX_GPIO_Init(void)
{
  GPIO_InitTypeDef GPIO_InitStruct = {0};

  /* GPIO Ports Clock Enable */
  __HAL_RCC_GPIOI_CLK_ENABLE();
  __HAL_RCC_GPIOB_CLK_ENABLE();
  __HAL_RCC_GPIOE_CLK_ENABLE();
  __HAL_RCC_GPIOA_CLK_ENABLE();
  __HAL_RCC_GPIOH_CLK_ENABLE();
  __HAL_RCC_GPIOG_CLK_ENABLE();
  __HAL_RCC_GPIOC_CLK_ENABLE();
  __HAL_RCC_GPIOF_CLK_ENABLE();
  __HAL_RCC_GPIOK_CLK_ENABLE();
  __HAL_RCC_GPIOJ_CLK_ENABLE();
  __HAL_RCC_GPIOD_CLK_ENABLE();

  /*Configure GPIO pin Output Level */
  HAL_GPIO_WritePin(EXPANDER_RST_GPIO_Port, EXPANDER_RST_Pin, GPIO_PIN_SET);

  /*Configure GPIO pin Output Level */
  HAL_GPIO_WritePin(ETH_RST_N_GPIO_Port, ETH_RST_N_Pin, GPIO_PIN_SET);

  /*Configure GPIO pin Output Level */
  HAL_GPIO_WritePin(GPIOG, IPMB_B_EN_Pin|IPMB_A_EN_Pin, GPIO_PIN_RESET);

  /*Configure GPIO pin Output Level */
  HAL_GPIO_WritePin(ETH_TX_ER_GPIO_Port, ETH_TX_ER_Pin, GPIO_PIN_RESET);

  /*Configure GPIO pin Output Level */
  HAL_GPIO_WritePin(GPIOD, EN_12V_Pin|FP_LED_2_Pin|FP_LED_0_Pin|FP_LED_1_Pin
                          |FP_LED_BLUE_Pin, GPIO_PIN_RESET);

  /*Configure GPIO pin Output Level */
  HAL_GPIO_WritePin(PYLD_RESET_GPIO_Port, PYLD_RESET_Pin, GPIO_PIN_SET);

  /*Configure GPIO pins : I2C_BB_SCL_Pin I2C_BB_SDA_Pin */
  GPIO_InitStruct.Pin = I2C_BB_SCL_Pin|I2C_BB_SDA_Pin;
  GPIO_InitStruct.Mode = GPIO_MODE_INPUT;
  GPIO_InitStruct.Pull = GPIO_PULLUP;
  HAL_GPIO_Init(GPIOI, &GPIO_InitStruct);

  /*Configure GPIO pins : IPM_0_Pin IPM_1_Pin IPM_3_Pin IPM_4_Pin
                           IPM_5_Pin USR_IO_10_Pin */
  GPIO_InitStruct.Pin = IPM_0_Pin|IPM_1_Pin|IPM_3_Pin|IPM_4_Pin
                          |IPM_5_Pin|USR_IO_10_Pin;
  GPIO_InitStruct.Mode = GPIO_MODE_INPUT;
  GPIO_InitStruct.Pull = GPIO_NOPULL;
  HAL_GPIO_Init(GPIOI, &GPIO_InitStruct);

  /*Configure GPIO pins : USR_IO_6_Pin USR_IO_27_Pin USR_IO_14_Pin HANDLE_Pin
                           USR_IO_12_Pin PWR_GOOD_B_Pin USR_IO_33_Pin */
  GPIO_InitStruct.Pin = USR_IO_6_Pin|USR_IO_27_Pin|USR_IO_14_Pin|HANDLE_Pin
                          |USR_IO_12_Pin|PWR_GOOD_B_Pin|USR_IO_33_Pin;
  GPIO_InitStruct.Mode = GPIO_MODE_INPUT;
  GPIO_InitStruct.Pull = GPIO_NOPULL;
  HAL_GPIO_Init(GPIOB, &GPIO_InitStruct);

  /*Configure GPIO pins : USR_IO_0_Pin USR_IO_1_Pin IPM_11_Pin USR_IO_23_Pin
                           USR_IO_25_Pin USR_IO_28_Pin USR_IO_29_Pin USR_IO_20_Pin
                           USR_IO_24_Pin USR_IO_22_Pin USR_IO_26_Pin */
  GPIO_InitStruct.Pin = USR_IO_0_Pin|USR_IO_1_Pin|IPM_11_Pin|USR_IO_23_Pin
                          |USR_IO_25_Pin|USR_IO_28_Pin|USR_IO_29_Pin|USR_IO_20_Pin
                          |USR_IO_24_Pin|USR_IO_22_Pin|USR_IO_26_Pin;
  GPIO_InitStruct.Mode = GPIO_MODE_INPUT;
  GPIO_InitStruct.Pull = GPIO_NOPULL;
  HAL_GPIO_Init(GPIOE, &GPIO_InitStruct);

  /*Configure GPIO pin : EXPANDER_INT_Pin */
  GPIO_InitStruct.Pin = EXPANDER_INT_Pin;
  GPIO_InitStruct.Mode = GPIO_MODE_IT_FALLING;
  GPIO_InitStruct.Pull = GPIO_PULLUP;
  HAL_GPIO_Init(EXPANDER_INT_GPIO_Port, &GPIO_InitStruct);

  /*Configure GPIO pin : EXPANDER_RST_Pin */
  GPIO_InitStruct.Pin = EXPANDER_RST_Pin;
  GPIO_InitStruct.Mode = GPIO_MODE_OUTPUT_PP;
  GPIO_InitStruct.Pull = GPIO_NOPULL;
  GPIO_InitStruct.Speed = GPIO_SPEED_FREQ_LOW;
  HAL_GPIO_Init(EXPANDER_RST_GPIO_Port, &GPIO_InitStruct);

  /*Configure GPIO pins : IPM_14_Pin USR_IO_7_Pin IPM_7_Pin USR_IO_21_Pin
                           USR_IO_17_Pin */
  GPIO_InitStruct.Pin = IPM_14_Pin|USR_IO_7_Pin|IPM_7_Pin|USR_IO_21_Pin
                          |USR_IO_17_Pin;
  GPIO_InitStruct.Mode = GPIO_MODE_INPUT;
  GPIO_InitStruct.Pull = GPIO_NOPULL;
  HAL_GPIO_Init(GPIOG, &GPIO_InitStruct);

  /*Configure GPIO pins : USR_IO_34_Pin IPM_10_Pin USR_IO_4_Pin USR_IO_5_Pin
                           USR_IO_8_Pin USR_IO_9_Pin */
  GPIO_InitStruct.Pin = USR_IO_34_Pin|IPM_10_Pin|USR_IO_4_Pin|USR_IO_5_Pin
                          |USR_IO_8_Pin|USR_IO_9_Pin;
  GPIO_InitStruct.Mode = GPIO_MODE_INPUT;
  GPIO_InitStruct.Pull = GPIO_NOPULL;
  HAL_GPIO_Init(GPIOA, &GPIO_InitStruct);

  /*Configure GPIO pin : ETH_INT_N_Pin */
  GPIO_InitStruct.Pin = ETH_INT_N_Pin;
  GPIO_InitStruct.Mode = GPIO_MODE_INPUT;
  GPIO_InitStruct.Pull = GPIO_PULLUP;
  HAL_GPIO_Init(ETH_INT_N_GPIO_Port, &GPIO_InitStruct);

  /*Configure GPIO pin : ETH_RST_N_Pin */
  GPIO_InitStruct.Pin = ETH_RST_N_Pin;
  GPIO_InitStruct.Mode = GPIO_MODE_OUTPUT_PP;
  GPIO_InitStruct.Pull = GPIO_NOPULL;
  GPIO_InitStruct.Speed = GPIO_SPEED_FREQ_LOW;
  HAL_GPIO_Init(ETH_RST_N_GPIO_Port, &GPIO_InitStruct);

  /*Configure GPIO pins : IPM_13_Pin IPM_8_Pin USR_IO_2_Pin */
  GPIO_InitStruct.Pin = IPM_13_Pin|IPM_8_Pin|USR_IO_2_Pin;
  GPIO_InitStruct.Mode = GPIO_MODE_INPUT;
  GPIO_InitStruct.Pull = GPIO_NOPULL;
  HAL_GPIO_Init(GPIOC, &GPIO_InitStruct);

  /*Configure GPIO pins : IPM_2_Pin IPM_6_Pin IPM_12_Pin IPM_9_Pin
                           ALARM_A_Pin USR_IO_18_Pin USR_IO_19_Pin */
  GPIO_InitStruct.Pin = IPM_2_Pin|IPM_6_Pin|IPM_12_Pin|IPM_9_Pin
                          |ALARM_A_Pin|USR_IO_18_Pin|USR_IO_19_Pin;
  GPIO_InitStruct.Mode = GPIO_MODE_INPUT;
  GPIO_InitStruct.Pull = GPIO_NOPULL;
  HAL_GPIO_Init(GPIOF, &GPIO_InitStruct);

  /*Configure GPIO pins : IPMB_B_EN_Pin IPMB_A_EN_Pin */
  GPIO_InitStruct.Pin = IPMB_B_EN_Pin|IPMB_A_EN_Pin;
  GPIO_InitStruct.Mode = GPIO_MODE_OUTPUT_PP;
  GPIO_InitStruct.Pull = GPIO_NOPULL;
  GPIO_InitStruct.Speed = GPIO_SPEED_FREQ_LOW;
  HAL_GPIO_Init(GPIOG, &GPIO_InitStruct);

  /*Configure GPIO pin : IPMB_B_RDY_Pin */
  GPIO_InitStruct.Pin = IPMB_B_RDY_Pin;
  GPIO_InitStruct.Mode = GPIO_MODE_INPUT;
  GPIO_InitStruct.Pull = GPIO_PULLUP;
  HAL_GPIO_Init(IPMB_B_RDY_GPIO_Port, &GPIO_InitStruct);

  /*Configure GPIO pins : IPMB_A_RDY_Pin HW_5_Pin HW_7_Pin */
  GPIO_InitStruct.Pin = IPMB_A_RDY_Pin|HW_5_Pin|HW_7_Pin;
  GPIO_InitStruct.Mode = GPIO_MODE_INPUT;
  GPIO_InitStruct.Pull = GPIO_PULLUP;
  HAL_GPIO_Init(GPIOK, &GPIO_InitStruct);

  /*Configure GPIO pins : HW_3_Pin HW_1_Pin HW_6_Pin HW_4_Pin */
  GPIO_InitStruct.Pin = HW_3_Pin|HW_1_Pin|HW_6_Pin|HW_4_Pin;
  GPIO_InitStruct.Mode = GPIO_MODE_INPUT;
  GPIO_InitStruct.Pull = GPIO_PULLUP;
  HAL_GPIO_Init(GPIOJ, &GPIO_InitStruct);

  /*Configure GPIO pins : IPM_15_Pin MASTER_TDI_Pin MASTER_TMS_Pin USR_IO_11_Pin
                           USR_IO_31_Pin USR_IO_15_Pin USR_IO_13_Pin USR_IO_16_Pin */
  GPIO_InitStruct.Pin = IPM_15_Pin|MASTER_TDI_Pin|MASTER_TMS_Pin|USR_IO_11_Pin
                          |USR_IO_31_Pin|USR_IO_15_Pin|USR_IO_13_Pin|USR_IO_16_Pin;
  GPIO_InitStruct.Mode = GPIO_MODE_INPUT;
  GPIO_InitStruct.Pull = GPIO_NOPULL;
  HAL_GPIO_Init(GPIOJ, &GPIO_InitStruct);

  /*Configure GPIO pins : USR_IO_3_Pin MASTER_TCK_Pin PWR_GOOD_A_Pin USR_IO_32_Pin
                           USR_IO_30_Pin */
  GPIO_InitStruct.Pin = USR_IO_3_Pin|MASTER_TCK_Pin|PWR_GOOD_A_Pin|USR_IO_32_Pin
                          |USR_IO_30_Pin;
  GPIO_InitStruct.Mode = GPIO_MODE_INPUT;
  GPIO_InitStruct.Pull = GPIO_NOPULL;
  HAL_GPIO_Init(GPIOH, &GPIO_InitStruct);

  /*Configure GPIO pin : ETH_TX_ER_Pin */
  GPIO_InitStruct.Pin = ETH_TX_ER_Pin;
  GPIO_InitStruct.Mode = GPIO_MODE_OUTPUT_PP;
  GPIO_InitStruct.Pull = GPIO_NOPULL;
  GPIO_InitStruct.Speed = GPIO_SPEED_FREQ_LOW;
  HAL_GPIO_Init(ETH_TX_ER_GPIO_Port, &GPIO_InitStruct);

  /*Configure GPIO pins : HW_2_Pin HW_0_Pin */
  GPIO_InitStruct.Pin = HW_2_Pin|HW_0_Pin;
  GPIO_InitStruct.Mode = GPIO_MODE_INPUT;
  GPIO_InitStruct.Pull = GPIO_PULLUP;
  HAL_GPIO_Init(GPIOH, &GPIO_InitStruct);

  /*Configure GPIO pins : ALARM_B_Pin MASTER_TDO_Pin MASTER_TRST_Pin */
  GPIO_InitStruct.Pin = ALARM_B_Pin|MASTER_TDO_Pin|MASTER_TRST_Pin;
  GPIO_InitStruct.Mode = GPIO_MODE_INPUT;
  GPIO_InitStruct.Pull = GPIO_NOPULL;
  HAL_GPIO_Init(GPIOD, &GPIO_InitStruct);

  /*Configure GPIO pins : EN_12V_Pin FP_LED_2_Pin FP_LED_0_Pin FP_LED_1_Pin
                           FP_LED_BLUE_Pin */
  GPIO_InitStruct.Pin = EN_12V_Pin|FP_LED_2_Pin|FP_LED_0_Pin|FP_LED_1_Pin
                          |FP_LED_BLUE_Pin;
  GPIO_InitStruct.Mode = GPIO_MODE_OUTPUT_PP;
  GPIO_InitStruct.Pull = GPIO_NOPULL;
  GPIO_InitStruct.Speed = GPIO_SPEED_FREQ_LOW;
  HAL_GPIO_Init(GPIOD, &GPIO_InitStruct);

  /*Configure GPIO pin : PYLD_RESET_Pin */
  GPIO_InitStruct.Pin = PYLD_RESET_Pin;
  GPIO_InitStruct.Mode = GPIO_MODE_OUTPUT_PP;
  GPIO_InitStruct.Pull = GPIO_NOPULL;
  GPIO_InitStruct.Speed = GPIO_SPEED_FREQ_LOW;
  HAL_GPIO_Init(PYLD_RESET_GPIO_Port, &GPIO_InitStruct);

  /* EXTI interrupt init*/
  HAL_NVIC_SetPriority(EXTI3_IRQn, 5, 0);
  HAL_NVIC_EnableIRQ(EXTI3_IRQn);

}

/* USER CODE BEGIN 4 */

void HAL_UART_RxCpltCallback(UART_HandleTypeDef *UartHandle)
{

  BaseType_t xHigherPriorityTaskWoken = pdFALSE;

  if( UartHandle ==  &huart4 )
  {
    if( terminal_input_stream != NULL )
	  xStreamBufferSendFromISR( terminal_input_stream, &uart4_input_char, 1, &xHigherPriorityTaskWoken);

	HAL_UART_Receive_IT(&huart4, (uint8_t*)(&uart4_input_char), 1);
  }
}

// Receiver callback from telnet. Port 23: IPMC CLI
void telnet_receiver_callback_cli_23( uint8_t* buff, uint16_t len )
{
    if( terminal_input_stream != NULL )
    {
    	for( int i=0; i<len; ++i) if(buff[i] == 127) buff[i] = 8; //Convert DEL into BACK SPACE
    	xStreamBufferSend( terminal_input_stream, buff, len, 0);
    }
}

// Command callback from telnet. Port 23: IPMC CLI
void telnet_command_callback_cli_23( uint8_t* buff, uint16_t len )
{
	// Incoming telnet commands are ignored

	// When trying to negotiate, send the server conditions
	// WILL ECHO is used here to prevent local echo in the client
	uint8_t telnet_negotiation_commands[]={255, 251, 1, 255, 254, 34}; // WILL ECHO; DON'T LINEMODE
	telnet_transmit(&telnet23, telnet_negotiation_commands, 6);
}

/*
 * Task to manage character output via VCP
 *
 * This task takes care of accumulating bytes in a stream while VCP is busy.
 * In case it is busy, it takes care of retry while stream keeps accumulating
 */
static void vcp_output_task(void *argument)
{
	vcp_output_stream = xStreamBufferCreate(10, 1);
	uint8_t buff[10];

	while(1)
	{
		int rcvd = xStreamBufferReceive( vcp_output_stream, buff, 10, portMAX_DELAY );
		while( CDC_Transmit_FS(buff, rcvd) == USBD_BUSY )
			osDelay(50);
	}
}

void HAL_SPI_TxRxCpltCallback(SPI_HandleTypeDef *hspi)
{
	if( hspi == &hspi4 )
		amc_gpios_spi_interrupt();
}

void HAL_GPIO_EXTI_Callback(uint16_t GPIO_Pin)
{
	BaseType_t xHigherPriorityTaskWoken = pdFALSE;

	// Informs the AMC_GPIOs driver that a falling edge happened in AMC_SPI_INT signal
	if( GPIO_Pin == GPIO_PIN_3)
		if( amc_gpios_pin_interrupt_task_handle != NULL )
			vTaskNotifyGiveFromISR( amc_gpios_pin_interrupt_task_handle, &xHigherPriorityTaskWoken );

}

/*
 * Callback to attend interrupts generated by the the AMC_IOs
 *
 * This callback runs in a FreeRTOS task context. This is NOT a CPU
 * interrupt!
 *
 */
void amc_gpios_pin_interrupt_callback( amc_int_status_t* interrupt_status )
{

	// Example of interrupt check
	if(interrupt_status[AMC2_IO_6] == AMC_INT_STATUS_FALLED)
	{
		asm("nop");
	}
	if(interrupt_status[AMC6_IO_2] == AMC_INT_STATUS_RISED)
	{
		asm("nop");
	}
}

/*
 * Multithread printf.
 */
void mt_printf(const char* format, ...)
{
	va_list args;

	va_start( args, format );
	mt_vprintf( format, args );
	va_end( args );
}

void mt_vprintf(const char* format, va_list va)
{
	if( printf_mutex == NULL)
		return;

	// vprintf guarded by a mutex to prevent output conflict and string interleaving.
	xSemaphoreTake(printf_mutex, portMAX_DELAY);
	vprintf( format, va );
	xSemaphoreGive(printf_mutex);
}

/*
 * Implements the putchar for printf and vprintf
 */
void _putchar(char character)
{
	// Local CLI via UART
  // Commented out to disable UART0, which was crashing the system with spam from the zynq
	// HAL_UART_Transmit(&huart4, (uint8_t*)(&character), 1, 1000);

	// Remote CLI via telnet
	telnet_transmit(&telnet23, (uint8_t*)(&character), 1);

	// CLI on VCP
	if( vcp_output_stream != NULL )
		xStreamBufferSend( vcp_output_stream, (uint8_t*)(&character), 1, 0);
}

/* USER CODE END 4 */

void StartDefaultTask(void *argument)
{
  /* init code for LWIP */
  //MX_LWIP_Init();

  /* init code for USB_DEVICE */
  MX_USB_DEVICE_Init();

  /* USER CODE BEGIN 5 */

  // Initializations for DIMM peripherals and OpenIPMC
  openipmc_hal_init();
  amc_gpios_init();
  mgm_i2c_init();
  sense_i2c_init();

  // Apollo Inits
  mt_printf(" > Initializing User GPIOs...\r\n");
  apollo_init_gpios();
  apollo_init_bootmode();

  LED_0_SET_STATE(RESET);
  LED_1_SET_STATE(RESET);
  LED_2_SET_STATE(RESET);

  // Check for Benchtop mode
  if (0x41 == ipmc_ios_read_haddress()) {
    mt_printf("1U Shelf Detected... booting up in no shelf mode\r\n");
    set_benchtop_payload_power_level(1);
  }

  // send esm reset
  //------------------------------------------------------------------------------
  // WARNING:
  //
  //    enabling this ESM reset breaks network access for the IPMC
  //    it needs to be further investigated but for now DO NOT reset the ESM

  mt_printf(" > Resetting ESM...\r\n");
  while (0==apollo_get_esm_pwr_good()) {}

  // for rev1 boards, enabling the esm is tied to enabling the 12V
  // so keep the network off until the ESM comes up and resets
  if (apollo_get_revision() == APOLLO_REV1) {
    while (0==apollo_get_zynq_en()) {}
    osDelay(1000);
  }

  osDelay(100);

  MX_LWIP_Init();

  // Set network interface static IP Address
  const uint8_t ip_octet = ipmc_ios_read_haddress();
  eth_ctrls_change_ip_addr( 192, 168,  21, ip_octet,  // IP Address
                            255, 255,   0,  0,        // Network Mask
                            192, 168,   1,  4);       // Gateway

  // Opens telnet port 23 for the remote IPMC CLI
  telnet_create (&telnet23, 23, &telnet_receiver_callback_cli_23, &telnet_command_callback_cli_23);

  // UDP packet output test
  // osDelay(1000);
  // const char* message = "Hello UDP message!\n\r";
  // ip_addr_t PC_IPADDR;
  // IP_ADDR4(&PC_IPADDR, 192, 168, 0, 1);
  // struct udp_pcb* my_udp = udp_new();
  // udp_connect(my_udp, &PC_IPADDR, 55151);
  // struct pbuf* udp_buffer = NULL;

  /* Infinite loop */
  for(;;)
  {
    // UDP packet output test
    //udp_buffer = pbuf_alloc(PBUF_TRANSPORT, strlen(message), PBUF_RAM);
    //if (udp_buffer != NULL) {
    //  memcpy(udp_buffer->payload, message, strlen(message));
    //  udp_send(my_udp, udp_buffer);
    //  pbuf_free(udp_buffer);
    //}

    osDelay (30000); // once per minute
    apollo_write_zynq_i2c_constants ();
  }

  /* USER CODE END 5 */
}

void ipmc_fp_led_blink_task( void *argument )
{

    for (;;) {

      if (0==apollo_get_esm_pwr_good()) {

        // ESM power bad

        LED_0_SET_STATE(SET);
        LED_1_SET_STATE(SET);
        LED_2_SET_STATE(SET);
        osDelay(200);
        LED_0_SET_STATE(RESET);
        LED_1_SET_STATE(RESET);
        LED_2_SET_STATE(RESET);
        osDelay(200);

      } else if (ipmc_ios_read_handle() == APOLLO_HANDLE_OPEN) {

        // front panel opened
        LED_0_SET_STATE(SET);
        LED_1_SET_STATE(RESET);
        LED_2_SET_STATE(RESET);
        osDelay(300);
        LED_0_SET_STATE(RESET);
        LED_1_SET_STATE(SET);
        LED_2_SET_STATE(RESET);
        osDelay(300);
        LED_0_SET_STATE(RESET);
        LED_1_SET_STATE(RESET);
        LED_2_SET_STATE(SET);
        osDelay(300);

      } else if (apollo_get_ipmc_abnormal_shutdown() == 1) {

        // bad shutdown
        LED_0_SET_STATE(SET);
        LED_1_SET_STATE(SET);
        LED_2_SET_STATE(SET);
        osDelay(1000);
        LED_0_SET_STATE(RESET);
        LED_1_SET_STATE(RESET);
        LED_2_SET_STATE(RESET);
        osDelay(1000);

      } else if (apollo_get_ipmc_startup_started() == 0) {

        // haven't started powerup... power level is off or something

        LED_1_SET_STATE(RESET);
        LED_2_SET_STATE(RESET);

        LED_0_SET_STATE(SET);
        osDelay(1000);
        LED_0_SET_STATE(RESET);
        osDelay(1000);

      } else if (apollo_get_ipmc_startup_done() == 1) {

        // startup is done

        LED_1_SET_STATE(RESET);
        LED_2_SET_STATE(RESET);

        LED_0_SET_STATE(SET);
        osDelay(100);
        LED_0_SET_STATE(RESET);
        osDelay(100);

      } else if (apollo_get_fpga_done() == 0) {

        // fpga not up

        LED_2_SET_STATE(RESET);

        LED_1_SET_STATE(SET);
        LED_0_SET_STATE(RESET);
        osDelay(1000);
        LED_1_SET_STATE(RESET);
        LED_0_SET_STATE(SET);
        osDelay(1000);

      } else if (apollo_get_zynq_done_generic() == 0) {

        // zynq not up

        LED_2_SET_STATE(RESET);

        LED_1_SET_STATE(SET);
        LED_0_SET_STATE(RESET);
        osDelay(500);
        LED_1_SET_STATE(RESET);
        LED_0_SET_STATE(SET);
        osDelay(500);
      } else {
        LED_1_SET_STATE(RESET);
        LED_2_SET_STATE(RESET);

        LED_0_SET_STATE(SET);
        osDelay(3000);
        LED_0_SET_STATE(RESET);
        osDelay(3000);
      }
    }
}

/* MPU Configuration */

void MPU_Config(void)
{
  MPU_Region_InitTypeDef MPU_InitStruct = {0};

  /* Disables the MPU */
  HAL_MPU_Disable();
  /** Initializes and configures the Region and the memory to be protected
  */
  MPU_InitStruct.Enable = MPU_REGION_ENABLE;
  MPU_InitStruct.Number = MPU_REGION_NUMBER0;
  MPU_InitStruct.BaseAddress = 0x30040000;
  MPU_InitStruct.Size = MPU_REGION_SIZE_32KB;
  MPU_InitStruct.SubRegionDisable = 0x0;
  MPU_InitStruct.TypeExtField = MPU_TEX_LEVEL1;
  MPU_InitStruct.AccessPermission = MPU_REGION_FULL_ACCESS;
  MPU_InitStruct.DisableExec = MPU_INSTRUCTION_ACCESS_DISABLE;
  MPU_InitStruct.IsShareable = MPU_ACCESS_NOT_SHAREABLE;
  MPU_InitStruct.IsCacheable = MPU_ACCESS_NOT_CACHEABLE;
  MPU_InitStruct.IsBufferable = MPU_ACCESS_NOT_BUFFERABLE;

  HAL_MPU_ConfigRegion(&MPU_InitStruct);
  /** Initializes and configures the Region and the memory to be protected
  */
  MPU_InitStruct.Enable = MPU_REGION_ENABLE;
  MPU_InitStruct.Number = MPU_REGION_NUMBER1;
  MPU_InitStruct.BaseAddress = 0x30040000;
  MPU_InitStruct.Size = MPU_REGION_SIZE_256B;
  MPU_InitStruct.SubRegionDisable = 0x0;
  MPU_InitStruct.TypeExtField = MPU_TEX_LEVEL0;
  MPU_InitStruct.AccessPermission = MPU_REGION_FULL_ACCESS;
  MPU_InitStruct.DisableExec = MPU_INSTRUCTION_ACCESS_DISABLE;
  MPU_InitStruct.IsShareable = MPU_ACCESS_SHAREABLE;
  MPU_InitStruct.IsCacheable = MPU_ACCESS_NOT_CACHEABLE;
  MPU_InitStruct.IsBufferable = MPU_ACCESS_BUFFERABLE;

  HAL_MPU_ConfigRegion(&MPU_InitStruct);
  /* Enables the MPU */
  HAL_MPU_Enable(MPU_PRIVILEGED_DEFAULT);

}
void HAL_TIM_PeriodElapsedCallback(TIM_HandleTypeDef *htim)
{
  if (htim->Instance == TIM7) {
    HAL_IncTick();
  }
}

void Error_Handler(void)
{
  __disable_irq();
  while (1)
  {
  }
}

/************************ (C) COPYRIGHT STMicroelectronics *****END OF FILE****/

// file: CM7/Core/Src/freertos.c
/* USER CODE BEGIN Header */
/**
  ******************************************************************************
  * File Name          : freertos.c
  * Description        : Code for freertos applications
  ******************************************************************************
  * @attention
  *
  * <h2><center>&copy; Copyright (c) 2020 STMicroelectronics.
  * All rights reserved.</center></h2>
  *
  * This software component is licensed by ST under Ultimate Liberty license
  * SLA0044, the "License"; You may not use this file except in compliance with
  * the License. You may obtain a copy of the License at:
  *                             www.st.com/SLA0044
  *
  ******************************************************************************
  */
/* USER CODE END Header */

#include "FreeRTOS.h"
#include "task.h"
#include "main.h"

/* USER CODE BEGIN Includes */
#include "string.h"
/* USER CODE END Includes */

/* USER CODE BEGIN Variables */
extern UART_HandleTypeDef huart4;
/* USER CODE END Variables */

/* Hook prototypes */
void vApplicationStackOverflowHook(xTaskHandle xTask, signed char *pcTaskName);
void vApplicationMallocFailedHook(void);

/* USER CODE BEGIN 4 */
void vApplicationStackOverflowHook(xTaskHandle xTask, signed char *pcTaskName)
{
   /* Run time stack overflow checking is performed if
   configCHECK_FOR_STACK_OVERFLOW is defined to 1 or 2. This hook function is
   called if a stack overflow is detected. */

   HAL_UART_Transmit(&huart4, (uint8_t*)"STACK OVERFLOW in task: ", 24, 1000);
   HAL_UART_Transmit(&huart4, (uint8_t*)pcTaskName, strlen((const char*)pcTaskName), 1000);
   HAL_UART_Transmit(&huart4, (uint8_t*)"\n\r", 2, 1000);
}
/* USER CODE END 4 */

/* USER CODE BEGIN 5 */
void vApplicationMallocFailedHook(void)
{
   /* vApplicationMallocFailedHook() will only be called if
   configUSE_MALLOC_FAILED_HOOK is set to 1 in FreeRTOSConfig.h. It is a hook
   function that will get called if a call to pvPortMalloc() fails.
   pvPortMalloc() is called internally by the kernel whenever a task, queue,
   timer or semaphore is created. It is also called by various parts of the
   demo application. If heap_1.c or heap_2.c are used, then the size of the
   heap available to pvPortMalloc() is defined by configTOTAL_HEAP_SIZE in
   FreeRTOSConfig.h, and the xPortGetFreeHeapSize() API function can be used
   to query the size of free heap space that remains (although it does not
   provide information on how the remaining heap might be fragmented). */

   HAL_UART_Transmit(&huart4, (uint8_t*)"MALLOC FAILURE in FreeRTOS heap\n\r", 33, 1000);

}
/* USER CODE END 5 */

/************************ (C) COPYRIGHT STMicroelectronics *****END OF FILE****/
